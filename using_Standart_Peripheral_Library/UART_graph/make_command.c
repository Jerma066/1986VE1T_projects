
#include "make_command.h"
#include "link.h"


//--------------------------------------------------------------------------------------------
//Функция для замены неугодных символов 0
//			 				параметры:	Str - указатель на строку, которую необходимо преобразовать;
//													Len - номер элемента до которого нужно производить преобразование;
//нет возвращаемых значений
//--------------------------------------------------------------------------------------------

void DestructStr (char* Str, int pos)
{
	for (int j=0; j < pos+1; j++)
	{
		Str[j] = '0';
	}
}

//--------------------------------------------------------------------------------------------
//Функция для нахождения позиции искомого элемента в строке (когда он встречается первый раз)
//			 				параметры:	Str - указатель на строку, которую необходимо преобразовать;
//													Len - длина всей строки;
//													sym - искомый элемент;
//Возвращает позицую на которой находится искомый элемент
//--------------------------------------------------------------------------------------------

int Find_Position (char* Str, int Len, char sym)
{	
	int LenCommand = 0;
	while((LenCommand++) < Len)
	{
		if(Str[LenCommand] == sym)
		{
			break;
		}
	}		
	
	return LenCommand;
}	


//----------------------------------------------------------------------------------------------
//Функция для нахождения и преобразования первого числа в строке в число. 
//Все что написано до него превращается в '#'(и оно само)
//Используя функцию n раз можнайти n-ое записанное число 
//			 				параметры:	Str - указатель на строку, которую необходимо преобразовать;
//Возвращает число типа данных int
//----------------------------------------------------------------------------------------------
int MakeNumber (char* Str, int len)
{
  int num = 0; // число
  int i = 0;
	int j = 0;
	
	while (((Str[i] < 0x30) || (Str[i] > 0x39)) && (i < len))
	{
		Str[i] = '0';
		i++;
	}		
	
	i=0;
	
  while (Str[i] >= 0x30 && Str[i] <= 0x39)
  {
    num = num + (Str[i] & 0x0F);
    num = num * 10;
    i++;
  }
  num = num / 10;
    
	if (i <= len)
	{
		for (j = 0; j<= i; j++)
		{
			Str[j] = '#';
		}
	}		
	
  return(num);
}	


//--------------------------------------------------------------------------------------------
//Исполнитель комманд = Библиотека графических комманд
//			 				параметры:	command - намиенование исполняемой комманды;
//													a[6]- массив координат отрисовки;
//нет возвращаемых значений
//--------------------------------------------------------------------------------------------

void LCD_ExecCommand(char* command, int a[6])
{
	
	int k = 0;	
	/*char message1[10] = "Circle";
	char message2[10] = "Line"; 
	char message3[10] = "Rectangle"; 
	char message4[10] = "Triangle"; 
	char message5[10] = "Point";*/
	
	/*обработка текстовой части команды*/
	
	if (strncmp(command,"Circle",6) == 0) {DrawCircle(a[0], a[1], a[2]); k++;} 
	if (strncmp(command,"Line",4) == 0) {DrawLine(a[0], a[1], a[2], a[3]); k++;} 
	if (strncmp(command,"Rectangle",9) == 0) {DrawRect (a[0], a[1], a[2], a[3]); k++;} 
	if (strncmp(command,"Triangle",8) == 0) {DrawTriangle (a[0], a[1], a[2], a[3], a[4], a[5]); k++;}
	if (strncmp(command,"Point",5) == 0) {PutPixel(a[0], a[1]); k++;}
	
	if (k==0) 
	{
		PrintConstText ("Unkonwn command", 7, 37);
	}

}		

//--------------------------------------------------------------------------------------------------------------
//Функция преобразующая полученную строку в команду и массив координат
//			 				параметры:	argument - указатель на строку, в которую будет записана сформированная команда
//нет возвращаемых значений
//--------------------------------------------------------------------------------------------------------------
void MakeCommand(char* argument)
{
	int a[6];
	char command[19];
	int LenCommand, Len;
	
	for (int k=0; k<19; k++) {command[k] = 0;}
	
	Len = StrLen(argument); 
	LenCommand = Find_Position(argument, Len, ' '); 
	strncpy (command, argument, LenCommand); 
	
	for(int j=0; j<6; j++)
	{ 
		a[j] = MakeNumber(argument, Len);
	} 
	
	
	PrintConstText (command, 7, 37);
	LCD_ExecCommand(command, a);

}
//--------------------------------------------------------------------------------------------------------------
//Функция формирующая строку команды посимвольно из данных полученный с UART
//			 				параметры:	Fullstring - указатель на строку, в которую будет записываться формуруемая команда;
//													data - очередной полученный символ с UART;
//нет возвращаемых значений
//--------------------------------------------------------------------------------------------------------------
void PutSymbolInCommand(char* FullString, char data, int* i) 
{
	if ((data != 0x0D) && (*i<21))
	{
		FullString[*i] = data;
		(*i)++;
	}
	else 
	{
		(*i) = 0;
		if (strlen(FullString) > 4) {MakeCommand(FullString);}
	}
	
	//PrintConstText(FullString, 3, 0);
}
