
#ifndef LCDB_C
#define LCDB_C

/************************************************
*** Функции для работы с дисплеем МЭЛТ МТ-12864А
***	функции высокого уровня
************************************************/

#include "font.h"
#include "LCD.h"
#include "LCD_b.h"

//--------------------------------------------------------------------------------------
//Функция для вычисления длины строки символов
//			 				параметры:	Str - указатель на строку, размер которой необходимо узнать
//возвращаемые значеня: кол-во байт, занимаемое строкой
//--------------------------------------------------------------------------------------
uint32_t StrLen(char* Str)
{
	char* ptr;
	uint32_t Len;

	ptr = Str;
	Len = 0;
	while(*(ptr++)!=0x00)	Len++;

	return Len;
}


//--------------------------------------------------------------------------------------
//Функция для вычисления позиции на которой будет находиться число
//			 				  параметры:	Str - указатель на строку, в которой  
//							  находится % - обозначение позиции числа в тексте 
//возвращаемые значеня: кол-во байт, занимаемое строкой
//--------------------------------------------------------------------------------------
uint32_t FindPosition(char* Str, uint32_t Length)
{
	uint32_t LenWord=0;
	while(LenWord++ < Length)
		if(Str[LenWord]=='%'){return LenWord;};
	
} 


//--------------------------------------------------------------------------------------
//Функция для перевода числа Val в массив символов, на который указывает MyStr
//параметры:	MyStr - указатель на строку, в которую будет помещен результат
//	 				  (массив должен содержать 32 символа)
//     				Value - значение, которое необходимо отобразить на экране
//	   				Len - указатель, по которому будет находиться кол-во элементов в
//            массиве (не включая терминальный 0)
//возвращаемых значений нет
//--------------------------------------------------------------------------------------
void DigitalToChar(uint8_t* MyStr, uint32_t Val, uint32_t* Len)
{
	uint32_t f,i,j,non=0;
	uint8_t Arr[33];

	
	for(i=0; i<10; i++)
	{
		
		f = Val % 10;
		Arr[i]=0x30+f;
		Val=Val / 10;
		
		if(Val==0)	//отбрасываем лишние нули
		{
			non=i;
			break;
		}
	}

//Начинаем формировать результирующий массив символов
		if(non==0)
		{
			MyStr[0] = Arr[0];
			MyStr[1] = 0;
			*Len = 1;
			return;
		}
		else
		{
			*Len = 0;
			j = non;
			for(i=0; i<=non; i++)
			{
				MyStr[i] = Arr[j--];
				(*Len)++;
			}
			MyStr[i] = 0;
			return;
		}
	}

	
//-------------------------------------------------------------------------------------------------------
//Функция для отображения одного символа на экране размером 6х8 пикселей (6 - ширина, 8 - высота)
//Параметры:	Symbol - символ, который надо отобразить
//						Crystal - кристалл LCD, на котором надо отобразить символ
// 						Adress - позиция по горизонтали 
//-------------------------------------------------------------------------------------------------------
void PrintSymbol(uint8_t Symbol, uint8_t Address)
{
	uint32_t Offset= (Symbol - FONT_MIN_CODE)* FONT_WIDTH;
	
		for(int i = Offset; i< (Offset+6); i++) 
		 {
				 Address ++;
			   WriteByte(Font_6x8_Data[i],Address);
		 }		

}


//-------------------------------------------------------------------------------------------------------
//Функция для отображения константной строки на экране
//Параметры:	String - указатель на константную строку, которую надо вывести
//						Page - страница ОЗУ LCD, на которой требуется отобразить текст (номер строки)
//						Address - адрес, с которого необходимо выводить текст на LCD (позиция по горизонтали )
// 						возвращаемых значений нет
//в строке последний байт должен быть 0х00!
//-------------------------------------------------------------------------------------------------------
void PrintConstText(char* String, uint8_t Page, uint8_t Address)
{
//используется страничное деление экрана!
	int LenWord, Length=0;

	ClearPage(Page,First);
	ClearPage(Page,Second);
	
	SetPage(Page,First);
	SetPage(Page,Second);


	Length = StrLen(String);
	for(LenWord=0;LenWord<Length;LenWord++)
	{	
		Address+=6;
		PrintSymbol(String[LenWord],(Address - 6));
  }
}

//--------------------------------------------------------------------------------------------------
//Функция для отображения текста и вставки числа на экране (выводятся целые беззнаковые числа)
//Параметры:	Text - указатель на строку, которую надо вывести
//						Value - значение, которое необходимо отобразить на экране
//					  Page - страница ОЗУ LCD, на которой требуется отобразить текст
//					  Address - адрес, с которого необходимо выводить текст на LCD 
//						Method - способ отображения текста на экране (на белом фоне или на темном фоне)
//						ntn - система счисления, в которой выводить цифровую информацию
//возвращаемых значений нет
//в строке последний байт должен быть 0х00!
//--------------------------------------------------------------------------------------------------
void PrintText(char* String, uint32_t Value, uint8_t Page, uint8_t Address)
{
//используется страничное деление экрана!
	uint32_t LenWord=0, Length=0, PositionForInsert=0, Temp, ValNumOfChar, ptr;
	uint8_t  CharVal[33];
	char* ms, NewStr[21];
	
  ms = String;
	
//вычисляем длину строки
	Length = StrLen(String);
	if(Length>21) {Length = 21;} 

//вычисляем место вставки значения Value	
	PositionForInsert = FindPosition(String, Length);
	
//Переводим значение Value в массив символов
	DigitalToChar(&CharVal[0],Value,&ValNumOfChar);
	
//Формируем новую строку до вставки
	for(Temp=0; Temp<PositionForInsert; Temp++)	
					NewStr[Temp] = ms[Temp];
	
  if((ValNumOfChar+Temp)>21)
  {
	  do
			 {
				 ValNumOfChar--;
			 } while ((ValNumOfChar+Temp > 21)&&(LenWord!=0));
  }	

 ValNumOfChar+=Temp;
 for(LenWord=0;Temp<ValNumOfChar;Temp++)	NewStr[Temp] = CharVal[LenWord++];

//Дописываем то, что осталось после вставки
	LenWord = Length - (PositionForInsert + 1);
	PositionForInsert++;
	if((Temp < 21)&&(LenWord!=0))
		do
			{
				Temp++;
				LenWord--;
				NewStr[Temp-1] = ms[PositionForInsert++];
			} while ((Temp < 21)&&(LenWord!=0));
			
	PrintConstText(NewStr, Page, Address);
}


#endif
